/* Copyright (c) 2014-2015, The Linux Foundation. All rights reserved.
 *
 * This program is free software; you can redistribute it and/or modify
 * it under the terms of the GNU General Public License version 2 and
 * only version 2 as published by the Free Software Foundation.
 *
 * This program is distributed in the hope that it will be useful,
 * but WITHOUT ANY WARRANTY; without even the implied warranty of
 * MERCHANTABILITY or FITNESS FOR A PARTICULAR PURPOSE.  See the
 * GNU General Public License for more details.
 */

qcom,scorpio_main_source {
	/* #2422106_Asus_Scorpio8937_2900mAh_averaged_MasterSlave_May6th2016*/
	qcom,max-voltage-uv = <4380000>;
	qcom,nom-batt-capacity-mah = <2900>;
	qcom,batt-id-kohm = <51>;
	qcom,battery-beta = <3435>;
	qcom,battery-type = "scorpio_main_source";
	qcom,chg-rslow-comp-c1 = <4016704>;
	qcom,chg-rslow-comp-c2 = <7196391>;
	qcom,chg-rs-to-rslow = <1103063>;
	qcom,chg-rslow-comp-thr = <0xB8>;
	qcom,checksum = <0x7ED5>;
	qcom,gui-version = "PMI8950GUI - 2.0.0.16";
	qcom,fg-profile-data = [
		 ED 83 34 7D 
		 2B 81 50 77 
		 5C 83 B8 67 
		 70 83 38 8E 
		 18 82 79 9A 
		 9F BD AF CA 
		 5A 0E EB 83 
		 76 7C 66 80 
		 87 75 64 83 
		 0A 67 83 88 
		 4E 94 59 82 
		 99 99 E6 BC 
		 C5 C9 52 0D 
		 8E 0B CE 5A 
		 91 6F 29 FC 
		 E1 36 96 45 
		 EB 40 00 00 
		 D0 46 21 2C 
		 A6 3B 00 00 
		 00 00 00 00 
		 00 00 00 00 
		 BF 70 54 6B 
		 48 67 EB 88 
		 09 7C CA 70 
		 89 6D 24 7A 
		 CA 75 E7 69 
		 84 63 1A AB 
		 21 06 60 66 
		 5D A0 71 0C 
		 28 00 FF 36 
		 F0 11 30 03 
		 00 00 00 0C 
	];
};

qcom,gemini_main_source {
	/* #2423927_Asus_Gemini_2330mAh_averaged_MasterSlave_May10th2016*/
	qcom,max-voltage-uv = <4380000>;
	qcom,nom-batt-capacity-mah = <2330>;
	qcom,batt-id-kohm = <51>;
	qcom,battery-beta = <3435>;
	qcom,battery-type = "gemini_main_source";
	qcom,chg-rslow-comp-c1 = <3023062>;
	qcom,chg-rslow-comp-c2 = <4046713>;
	qcom,chg-rs-to-rslow = <851616>;
	qcom,chg-rslow-comp-thr = <0xA0>;
	qcom,checksum = <0xE519>;
	qcom,gui-version = "PMI8950GUI - 2.0.0.16";
	qcom,fg-profile-data = [
		 EB 83 19 7D 
		 2D 81 6A 77 
		 5C 83 B1 67 
		 31 83 C6 8D 
		 31 82 48 99 
		 F9 B7 10 C8 
		 5A 0F 06 88 
		 C5 7D 8C 81 
		 F5 77 48 83 
		 51 72 DC 76 
		 E8 2E 58 82 
		 3A 99 55 BC 
		 D4 C8 5E 0D 
		 25 09 E2 5B 
		 91 6F EE FC 
		 CD 3D 02 3E 
		 FE 3A 00 00 
		 D0 44 27 29 
		 5F 28 00 00 
		 00 00 00 00 
		 00 00 00 00 
		 A2 6B 36 6A 
		 A2 6A B6 88 
		 BF 74 79 68 
		 1B 55 01 7B 
		 63 6F D1 61 
		 3C 7E C0 AA 
		 1A 0D 63 83 
		 64 A0 71 0C 
		 28 00 FF 36 
		 F0 11 30 03 
		 00 00 00 0C 
	];
};

qcom,scorpio_2nd_source {
	/* #2422581_Asus_Scorpio_2900mAh_averaged_MasterSlave_May11th2016*/
	qcom,max-voltage-uv = <4380000>;
	qcom,nom-batt-capacity-mah = <2900>;
	qcom,batt-id-kohm = <10>;
	qcom,battery-beta = <3435>;
	qcom,battery-type = "scorpio_2nd_source";
	qcom,chg-rslow-comp-c1 = <2916300>;
	qcom,chg-rslow-comp-c2 = <4607740>;
	qcom,chg-rs-to-rslow = <824655>;
	qcom,chg-rslow-comp-thr = <0xB1>;
	qcom,checksum = <0x2B4F>;
	qcom,gui-version = "PMI8950GUI - 2.0.0.16";
	qcom,fg-profile-data = [
		 FB 83 A6 7D 
		 88 81 07 7C 
		 4D 83 9F 68 
		 D5 73 9A 7F 
		 36 82 9E 99 
		 9F BC 2A C9 
		 62 0E 07 88 
		 FF 7D C7 81 
		 42 7C 5A 83 
		 69 62 06 80 
		 39 8C 50 82 
		 D8 99 48 BD 
		 75 CA 5B 0D 
		 60 0B 5B 5B 
		 91 6F 29 FC 
		 0D 3C D5 46 
		 5F 40 00 00 
		 5C 46 6E 1B 
		 6E 3B 00 00 
		 00 00 00 00 
		 00 00 00 00 
		 58 70 D1 6A 
		 10 77 97 89 
		 9F 77 64 70 
		 93 6E 0A 7A 
		 36 75 4B 69 
		 51 6C DA A2 
		 23 9D 60 B1 
		 5E A0 71 0C 
		 28 00 FF 36 
		 F0 11 30 03 
		 00 00 00 0C 
	];
};
