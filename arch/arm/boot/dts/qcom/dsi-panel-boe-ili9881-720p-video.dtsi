/* Copyright (c) 2013, The Linux Foundation. All rights reserved.
 *
 * This program is free software; you can redistribute it and/or modify
 * it under the terms of the GNU General Public License version 2 and
 * only version 2 as published by the Free Software Foundation.
 *
 * This program is distributed in the hope that it will be useful,
 * but WITHOUT ANY WARRANTY; without even the implied warranty of
 * MERCHANTABILITY or FITNESS FOR A PARTICULAR PURPOSE.  See the
 * GNU General Public License for more details.
 */

/*---------------------------------------------------------------------------
 * This file is autogenerated file using gcdb parser. Please do not edit it.
 * Update input XML file to add a new entry or update variable in this file
 * VERSION = "1.0"
 *---------------------------------------------------------------------------*/
&mdss_mdp {
	dsi_boe_ili9881_720p_video: qcom,mdss_dsi_boe_ili9881_720p_video {
		qcom,mdss-dsi-panel-name = "BOE ILI9881 720p video mode dsi panel";
		qcom,mdss-dsi-panel-controller = <&mdss_dsi0>;
		qcom,mdss-dsi-panel-type = "dsi_video_mode";
		qcom,mdss-dsi-panel-destination = "display_1";
		qcom,mdss-dsi-panel-framerate = <60>;
		qcom,mdss-dsi-virtual-channel-id = <0>;
		qcom,mdss-dsi-stream = <0>;
		qcom,mdss-dsi-panel-width = <720>;
		qcom,mdss-dsi-panel-height = <1280>;
		qcom,mdss-dsi-h-front-porch = <74>;
		qcom,mdss-dsi-h-back-porch = <74>;
		qcom,mdss-dsi-h-pulse-width = <8>;
		qcom,mdss-dsi-h-sync-skew = <0>;
		qcom,mdss-dsi-v-back-porch = <16>;
		qcom,mdss-dsi-v-front-porch = <8>;
		qcom,mdss-dsi-v-pulse-width = <8>;
		qcom,mdss-dsi-h-left-border = <0>;
		qcom,mdss-dsi-h-right-border = <0>;
		qcom,mdss-dsi-v-top-border = <0>;
		qcom,mdss-dsi-v-bottom-border = <0>;
		qcom,mdss-dsi-bpp = <24>;
		qcom,mdss-dsi-color-order = "rgb_swap_rgb";
		qcom,mdss-dsi-underflow-color = <0xff>;
		qcom,mdss-dsi-border-color = <0>;
		qcom,mdss-dsi-on-command = [39 01 00 00 00 00 04 FF 98 81 03
15 01 00 00 00 00 02 01 00
15 01 00 00 00 00 02 02 00
15 01 00 00 00 00 02 03 73
15 01 00 00 00 00 02 04 00
15 01 00 00 00 00 02 05 00
15 01 00 00 00 00 02 06 0C
15 01 00 00 00 00 02 07 00
15 01 00 00 00 00 02 08 00
15 01 00 00 00 00 02 09 19
15 01 00 00 00 00 02 0a 01
15 01 00 00 00 00 02 0b 01
15 01 00 00 00 00 02 0c 0B
15 01 00 00 00 00 02 0d 01
15 01 00 00 00 00 02 0e 01
15 01 00 00 00 00 02 0f 19
15 01 00 00 00 00 02 10 1D
15 01 00 00 00 00 02 11 00
15 01 00 00 00 00 02 12 00
15 01 00 00 00 00 02 13 02
15 01 00 00 00 00 02 14 00
15 01 00 00 00 00 02 15 00
15 01 00 00 00 00 02 16 00
15 01 00 00 00 00 02 17 00
15 01 00 00 00 00 02 18 00
15 01 00 00 00 00 02 19 00
15 01 00 00 00 00 02 1a 00
15 01 00 00 00 00 02 1b 00
15 01 00 00 00 00 02 1c 00
15 01 00 00 00 00 02 1d 00
15 01 00 00 00 00 02 1e 44
15 01 00 00 00 00 02 1f C0
15 01 00 00 00 00 02 20 0A
15 01 00 00 00 00 02 21 03
15 01 00 00 00 00 02 22 0A
15 01 00 00 00 00 02 23 00
15 01 00 00 00 00 02 24 8C
15 01 00 00 00 00 02 25 8C
15 01 00 00 00 00 02 26 00
15 01 00 00 00 00 02 27 00
15 01 00 00 00 00 02 28 3B
15 01 00 00 00 00 02 29 03
15 01 00 00 00 00 02 2a 00
15 01 00 00 00 00 02 2b 00
15 01 00 00 00 00 02 2c 00
15 01 00 00 00 00 02 2d 00
15 01 00 00 00 00 02 2e 00
15 01 00 00 00 00 02 2f 00
15 01 00 00 00 00 02 30 00
15 01 00 00 00 00 02 31 00
15 01 00 00 00 00 02 32 00
15 01 00 00 00 00 02 33 00
15 01 00 00 00 00 02 34 00
15 01 00 00 00 00 02 35 00
15 01 00 00 00 00 02 36 00
15 01 00 00 00 00 02 37 00
15 01 00 00 00 00 02 38 00
15 01 00 00 00 00 02 39 00
15 01 00 00 00 00 02 3a 00
15 01 00 00 00 00 02 3b 00
15 01 00 00 00 00 02 3c 00
15 01 00 00 00 00 02 3d 00
15 01 00 00 00 00 02 3e 00
15 01 00 00 00 00 02 3f 00
15 01 00 00 00 00 02 40 00
15 01 00 00 00 00 02 41 00
15 01 00 00 00 00 02 42 00
15 01 00 00 00 00 02 43 00
15 01 00 00 00 00 02 44 00
15 01 00 00 00 00 02 50 01
15 01 00 00 00 00 02 51 23
15 01 00 00 00 00 02 52 45
15 01 00 00 00 00 02 53 67
15 01 00 00 00 00 02 54 89
15 01 00 00 00 00 02 55 ab
15 01 00 00 00 00 02 56 01
15 01 00 00 00 00 02 57 23
15 01 00 00 00 00 02 58 45
15 01 00 00 00 00 02 59 67
15 01 00 00 00 00 02 5a 89
15 01 00 00 00 00 02 5b ab
15 01 00 00 00 00 02 5c cd
15 01 00 00 00 00 02 5d ef
15 01 00 00 00 00 02 5e 11
15 01 00 00 00 00 02 5f 02
15 01 00 00 00 00 02 60 00
15 01 00 00 00 00 02 61 0C
15 01 00 00 00 00 02 62 0D
15 01 00 00 00 00 02 63 0E
15 01 00 00 00 00 02 64 0F
15 01 00 00 00 00 02 65 02
15 01 00 00 00 00 02 66 02
15 01 00 00 00 00 02 67 02
15 01 00 00 00 00 02 68 02
15 01 00 00 00 00 02 69 02
15 01 00 00 00 00 02 6a 02
15 01 00 00 00 00 02 6b 02
15 01 00 00 00 00 02 6c 02
15 01 00 00 00 00 02 6d 02
15 01 00 00 00 00 02 6e 05
15 01 00 00 00 00 02 6f 05
15 01 00 00 00 00 02 70 05
15 01 00 00 00 00 02 71 05
15 01 00 00 00 00 02 72 01
15 01 00 00 00 00 02 73 06
15 01 00 00 00 00 02 74 07
15 01 00 00 00 00 02 75 02
15 01 00 00 00 00 02 76 00
15 01 00 00 00 00 02 77 0C
15 01 00 00 00 00 02 78 0D
15 01 00 00 00 00 02 79 0E
15 01 00 00 00 00 02 7a 0F
15 01 00 00 00 00 02 7b 02
15 01 00 00 00 00 02 7c 02
15 01 00 00 00 00 02 7d 02
15 01 00 00 00 00 02 7e 02
15 01 00 00 00 00 02 7f 02
15 01 00 00 00 00 02 80 02
15 01 00 00 00 00 02 81 02
15 01 00 00 00 00 02 82 02
15 01 00 00 00 00 02 83 02
15 01 00 00 00 00 02 84 05
15 01 00 00 00 00 02 85 05
15 01 00 00 00 00 02 86 05
15 01 00 00 00 00 02 87 05
15 01 00 00 00 00 02 88 01
15 01 00 00 00 00 02 89 06
15 01 00 00 00 00 02 8A 07
39 01 00 00 00 00 04 FF 98 81 04
15 01 00 00 00 00 02 6C 15
15 01 00 00 00 00 02 6E 19
15 01 00 00 00 00 02 6F 25
15 01 00 00 00 00 02 8D 1F
15 01 00 00 00 00 02 87 BA
15 01 00 00 00 00 02 26 76
15 01 00 00 00 00 02 B2 D1
39 01 00 00 00 00 04 FF 98 81 01
15 01 00 00 00 00 02 22 0A
15 01 00 00 00 00 02 31 00
15 01 00 00 00 00 02 40 53
15 01 00 00 00 00 02 43 66
15 01 00 00 00 00 02 53 77
15 01 00 00 00 00 02 55 64
15 01 00 00 00 00 02 50 97
15 01 00 00 00 00 02 51 92
15 01 00 00 00 00 02 60 15
15 01 00 00 00 00 02 61 01
15 01 00 00 00 00 02 62 0C
15 01 00 00 00 00 02 63 00
15 01 00 00 00 00 02 A0 00
15 01 00 00 00 00 02 A1 0E
15 01 00 00 00 00 02 A2 19
15 01 00 00 00 00 02 A3 12
15 01 00 00 00 00 02 A4 13
15 01 00 00 00 00 02 A5 24
15 01 00 00 00 00 02 A6 19
15 01 00 00 00 00 02 A7 1D
15 01 00 00 00 00 02 A8 5A
15 01 00 00 00 00 02 A9 1C
15 01 00 00 00 00 02 AA 28
15 01 00 00 00 00 02 AB 4B
15 01 00 00 00 00 02 AC 17
15 01 00 00 00 00 02 AD 14
15 01 00 00 00 00 02 AE 48
15 01 00 00 00 00 02 AF 1E
15 01 00 00 00 00 02 B0 26
15 01 00 00 00 00 02 B1 49
15 01 00 00 00 00 02 B2 60
15 01 00 00 00 00 02 B3 3F
15 01 00 00 00 00 02 C0 00
15 01 00 00 00 00 02 C1 0E
15 01 00 00 00 00 02 C2 19
15 01 00 00 00 00 02 C3 12
15 01 00 00 00 00 02 C4 13
15 01 00 00 00 00 02 C5 24
15 01 00 00 00 00 02 C6 19
15 01 00 00 00 00 02 C7 1D
15 01 00 00 00 00 02 C8 5A
15 01 00 00 00 00 02 C9 1C
15 01 00 00 00 00 02 CA 28
15 01 00 00 00 00 02 CB 4B
15 01 00 00 00 00 02 CC 17
15 01 00 00 00 00 02 CD 14
15 01 00 00 00 00 02 CE 48
15 01 00 00 00 00 02 CF 1E
15 01 00 00 00 00 02 D0 26
15 01 00 00 00 00 02 D1 49
15 01 00 00 00 00 02 D2 60
15 01 00 00 00 00 02 D3 3F
39 01 00 00 00 00 04 FF 98 81 00
15 01 00 00 00 00 02 35 00
/*39 01 00 00 00 00 03 51 00 00
39 01 00 00 00 00 02 53 2C
39 01 00 00 00 00 02 55 02
39 01 00 00 00 00 03 68 04 00*/
05 01 00 00 78 00 02 11 00
05 01 00 00 14 00 02 29 00];
		qcom,mdss-dsi-off-command = [/*29 01 00 00 00 00 02 53 00*/
05 01 00 00 96 00 02 28 00
05 01 00 00 78 00 02 10 00];
		qcom,mdss-dsi-on-command-state = "dsi_lp_mode";
		qcom,mdss-dsi-off-command-state = "dsi_lp_mode";
		qcom,mdss-dsi-h-sync-pulse = <1>;
		qcom,mdss-dsi-traffic-mode = "burst_mode";
		qcom,mdss-dsi-lane-map = "lane_map_0123";
		qcom,mdss-dsi-bllp-eof-power-mode;
		qcom,mdss-dsi-bllp-power-mode;
		qcom,mdss-dsi-lane-0-state;
		qcom,mdss-dsi-lane-1-state;
		qcom,mdss-dsi-lane-2-state;
		qcom,mdss-dsi-lane-3-state;
		qcom,mdss-dsi-panel-timings = [76 18 10 00 3C 3E 14 1C 12 03 04 00];
		qcom,mdss-dsi-t-clk-post = <0x04>;
		qcom,mdss-dsi-t-clk-pre = <0x19>;
		qcom,mdss-dsi-bl-min-level = <8>;
		qcom,mdss-dsi-bl-max-level = <4095>;
		qcom,mdss-dsi-dma-trigger = "trigger_sw";
		qcom,mdss-dsi-mdp-trigger = "none";
		qcom,mdss-dsi-bl-pmic-control-type = "bl_ctrl_wled";
		qcom,mdss-dsi-reset-sequence = <1 5>, <0 1>, <1 10>;
		qcom,mdss-dsi-lp11-init;
		qcom,mdss-pan-physical-width-dimension = <68>; //width of picture in mm (for xdpi)
		qcom,mdss-pan-physical-height-dimension = <121>; //height of picture in mm (for ydpi)
	};
};
