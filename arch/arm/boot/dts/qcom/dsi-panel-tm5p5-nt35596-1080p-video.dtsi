/* Copyright (c) 2013, The Linux Foundation. All rights reserved.
 *
 * This program is free software; you can redistribute it and/or modify
 * it under the terms of the GNU General Public License version 2 and
 * only version 2 as published by the Free Software Foundation.
 *
 * This program is distributed in the hope that it will be useful,
 * but WITHOUT ANY WARRANTY; without even the implied warranty of
 * MERCHANTABILITY or FITNESS FOR A PARTICULAR PURPOSE.  See the
 * GNU General Public License for more details.
 */

/*---------------------------------------------------------------------------
 * This file is autogenerated file using gcdb parser. Please do not edit it.
 * Update input XML file to add a new entry or update variable in this file
 * VERSION = "1.0"
 *---------------------------------------------------------------------------*/
&mdss_mdp {
	dsi_tm5p5_nt35596_1080p_video: qcom,mdss_dsi_tm5p5_nt35596_1080p_video {
		qcom,mdss-dsi-panel-name = "tm5p5 nt35596 1080p video mode dsi panel";
		qcom,mdss-dsi-panel-controller = <&mdss_dsi0>;
		qcom,mdss-dsi-panel-type = "dsi_video_mode";
		qcom,mdss-dsi-panel-destination = "display_1";
		qcom,mdss-dsi-panel-framerate = <60>;
		qcom,mdss-dsi-virtual-channel-id = <0>;
		qcom,mdss-dsi-stream = <0>;
		qcom,mdss-dsi-panel-width = <1080>;
		qcom,mdss-dsi-panel-height = <1920>;
		qcom,mdss-dsi-h-front-porch = <100>;
		qcom,mdss-dsi-h-back-porch = <16>;
		qcom,mdss-dsi-h-pulse-width = <8>;
		qcom,mdss-dsi-h-sync-skew = <0>;
		qcom,mdss-dsi-v-back-porch = <4>;
		qcom,mdss-dsi-v-front-porch = <4>;
		qcom,mdss-dsi-v-pulse-width = <2>;
		qcom,mdss-dsi-h-left-border = <0>;
		qcom,mdss-dsi-h-right-border = <0>;
		qcom,mdss-dsi-v-top-border = <0>;
		qcom,mdss-dsi-v-bottom-border = <0>;
		qcom,mdss-dsi-bpp = <24>;
		qcom,mdss-dsi-color-order = "rgb_swap_rgb";
		qcom,mdss-dsi-underflow-color = <0xff>;
		qcom,mdss-dsi-border-color = <0>;
		qcom,mdss-dsi-on-command = [
				//CMD3_PA
				29 01 00 00 00 00 02 FF EE
				29 01 00 00 64 00 02 18 40
				29 01 00 00 C8 00 02 18 00
				//CMD2_P4                           
				29 01 00 00 00 00 02 FF 05
				29 01 00 00 00 00 02 C5 31
				29 01 00 00 C8 00 02 FB 01
				//CMD2_P0
				29 01 00 00 00 00 02 FF 01
				29 01 00 00 00 00 02 00 01
				29 01 00 00 00 00 02 01 55
				29 01 00 00 00 00 02 02 40
				29 01 00 00 00 00 02 05 50
				29 01 00 00 00 00 02 06 4A
				29 01 00 00 00 00 02 07 29
				29 01 00 00 00 00 02 08 0C
				29 01 00 00 00 00 02 0B 9B
				29 01 00 00 00 00 02 0C 9B
				29 01 00 00 00 00 02 0E B0
				29 01 00 00 00 00 02 0F B3
				29 01 00 00 00 00 02 11 10
				29 01 00 00 00 00 02 12 10
				29 01 00 00 00 00 02 13 03
				29 01 00 00 00 00 02 14 4A
				29 01 00 00 00 00 02 15 12
				29 01 00 00 00 00 02 16 12
				29 01 00 00 00 00 02 18 00
				29 01 00 00 00 00 02 19 77
				29 01 00 00 00 00 02 1A 55
				29 01 00 00 00 00 02 1B 13
				29 01 00 00 00 00 02 1C 00
				29 01 00 00 00 00 02 1D 00
				29 01 00 00 00 00 02 1E 00
				29 01 00 00 00 00 02 1F 00
				29 01 00 00 00 00 02 58 82
				29 01 00 00 00 00 02 59 02
				29 01 00 00 00 00 02 5A 02
				29 01 00 00 00 00 02 5B 02
				29 01 00 00 00 00 02 5C 82
				29 01 00 00 00 00 02 5D 82
				29 01 00 00 00 00 02 5E 02
				29 01 00 00 00 00 02 5F 02
				29 01 00 00 00 00 02 72 31
				29 01 00 00 00 00 02 FB 01
				//CMD2_P4
				29 01 00 00 00 00 02 FF 05
				29 01 00 00 00 00 02 00 01
				29 01 00 00 00 00 02 01 0B
				29 01 00 00 00 00 02 02 0C
				29 01 00 00 00 00 02 03 09
				29 01 00 00 00 00 02 04 0A
				29 01 00 00 00 00 02 05 1A
				29 01 00 00 00 00 02 06 10
				29 01 00 00 00 00 02 07 00
				29 01 00 00 00 00 02 08 1A
				29 01 00 00 00 00 02 09 00
				29 01 00 00 00 00 02 0A 00
				29 01 00 00 00 00 02 0B 00
				29 01 00 00 00 00 02 0C 00
				29 01 00 00 00 00 02 0D 13
				29 01 00 00 00 00 02 0E 15
				29 01 00 00 00 00 02 0F 17
				29 01 00 00 00 00 02 10 01
				29 01 00 00 00 00 02 11 0B
				29 01 00 00 00 00 02 12 0C
				29 01 00 00 00 00 02 13 09
				29 01 00 00 00 00 02 14 0A
				29 01 00 00 00 00 02 15 1A
				29 01 00 00 00 00 02 16 10
				29 01 00 00 00 00 02 17 10
				29 01 00 00 00 00 02 18 1A
				29 01 00 00 00 00 02 19 00
				29 01 00 00 00 00 02 1A 00
				29 01 00 00 00 00 02 1B 00
				29 01 00 00 00 00 02 1C 00
				29 01 00 00 00 00 02 1D 13
				29 01 00 00 00 00 02 1E 15
				29 01 00 00 00 00 02 1F 17
				29 01 00 00 00 00 02 20 00
				29 01 00 00 00 00 02 21 03
				29 01 00 00 00 00 02 22 01
				29 01 00 00 00 00 02 23 36
				29 01 00 00 00 00 02 24 36
				29 01 00 00 00 00 02 25 6D
				29 01 00 00 00 00 02 29 D8
				29 01 00 00 00 00 02 2A 2A
				29 01 00 00 00 00 02 2B 00
				29 01 00 00 00 00 02 B6 92
				29 01 00 00 00 00 02 B7 B4
				29 01 00 00 00 00 02 B8 05
				29 01 00 00 00 00 02 4B 04
				29 01 00 00 00 00 02 4C 12
				29 01 00 00 00 00 02 4D 00
				29 01 00 00 00 00 02 4E 22
				29 01 00 00 00 00 02 4F 22
				29 01 00 00 00 00 02 50 00
				29 01 00 00 00 00 02 51 61
				29 01 00 00 00 00 02 52 01
				29 01 00 00 00 00 02 53 01
				29 01 00 00 00 00 02 54 75
				29 01 00 00 00 00 02 55 6D
				29 01 00 00 00 00 02 5B 44
				29 01 00 00 00 00 02 5C 00
				29 01 00 00 00 00 02 5F 74
				29 01 00 00 00 00 02 60 75
				29 01 00 00 00 00 02 63 FF
				29 01 00 00 00 00 02 64 00
				29 01 00 00 00 00 02 67 04
				29 01 00 00 00 00 02 68 04
				29 01 00 00 00 00 02 6C 00
				29 01 00 00 00 00 02 7A 80
				29 01 00 00 00 00 02 7B A3
				29 01 00 00 00 00 02 7C D8
				29 01 00 00 00 00 02 7D 60
				29 01 00 00 00 00 02 7E 0A
				29 01 00 00 00 00 02 7F 1A
				29 01 00 00 00 00 02 80 00
				29 01 00 00 00 00 02 83 00
				29 01 00 00 00 00 02 93 08
				29 01 00 00 00 00 02 94 0A
				29 01 00 00 00 00 02 8A 33
				29 01 00 00 00 00 02 9B 0F
				29 01 00 00 00 00 02 A4 0F	
				29 01 00 00 00 00 02 E7 80
				29 01 00 00 FF 00 02 FB 01
				//CMD1
				29 01 00 00 00 00 02 FF 00 
				29 01 00 00 00 00 02 D3 06 
				29 01 00 00 00 00 02 D4 04 
				29 01 00 00 00 00 02 35 00
				29 01 00 00 FF 00 02 11 00
				29 01 00 00 00 00 02 29 00
			 ];
		qcom,mdss-dsi-off-command = [05 01 00 00 3C 00 02 28 00
		05 01 00 00 00 00 02 10 00
                09 01 00 00 48 00 02 00 00
                15 01 00 00 00 00 02 4F 01
                ];
		qcom,mdss-dsi-on-command-state = "dsi_lp_mode";
		qcom,mdss-dsi-off-command-state = "dsi_lp_mode";
		qcom,mdss-dsi-h-sync-pulse = <1>;
		qcom,mdss-dsi-traffic-mode = "burst_mode";
		qcom,mdss-dsi-lane-map = "lane_map_0123";
		qcom,mdss-dsi-bllp-eof-power-mode;
		qcom,mdss-dsi-bllp-power-mode;
		qcom,mdss-dsi-lane-0-state;
		qcom,mdss-dsi-lane-1-state;
		qcom,mdss-dsi-lane-2-state;
		qcom,mdss-dsi-lane-3-state;
		qcom,mdss-dsi-panel-timings = [FA 41 3A 00 6A 8C 32 46 2F 03 04 00];
		qcom,mdss-dsi-t-clk-post = <0x04>;
		qcom,mdss-dsi-t-clk-pre = <0x33>;
		qcom,mdss-dsi-bl-min-level = <12>;
		qcom,mdss-dsi-bl-max-level = <4095>;
		qcom,mdss-dsi-dma-trigger = "trigger_sw";
		qcom,mdss-dsi-mdp-trigger = "none";
		qcom,mdss-dsi-bl-pmic-control-type = "bl_ctrl_wled";
		qcom,mdss-dsi-reset-sequence = <1 1>, <0 1>, <1 15>;
        qcom,mdss-pan-physical-width-dimension = <75>; //width of picture in mm (for xdpi)
		qcom,mdss-pan-physical-height-dimension = <132>; //height of picture in mm (for ydpi)
		qcom,mdss-dsi-lp11-init;
	};
};
