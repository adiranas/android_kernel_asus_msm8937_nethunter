/*
 * Copyright (c) 2015-2016, The Linux Foundation. All rights reserved.
 *
 * This program is free software; you can redistribute it and/or modify
 * it under the terms of the GNU General Public License version 2 and
 * only version 2 as published by the Free Software Foundation.
 *
 * This program is distributed in the hope that it will be useful,
 * but WITHOUT ANY WARRANTY; without even the implied warranty of
 * MERCHANTABILITY or FITNESS FOR A PARTICULAR PURPOSE.  See the
 * GNU General Public License for more details.
 */



&i2c_3 { /* BLSP1 QUP4 */   
	/*focaltech@38 {
		compatible = "focaltech,5X06";
		reg = <0x38>;
		interrupt-parent = <&tlmm>;
		interrupts = <65 0x2008>;
		vdd-supply = <&pm8917_l10>;
		vcc_i2c-supply = <&pm8917_l5>;*/
		/* pins used by touchscreen */
		/*pinctrl-names = "pmx_ts_active","pmx_ts_suspend","pmx_ts_release";
		pinctrl-0 = <&ts_int_active &ts_reset_active>;
		pinctrl-1 = <&ts_int_suspend &ts_reset_suspend>;
		pinctrl-2 = <&ts_release>;
		focaltech,name = "Ft5x46";
		focaltech,family-id = <0x54>;
		focaltech,reset-gpio = <&tlmm 64 0x0>;
		focaltech,irq-gpio = <&tlmm 65 0x2008>;
		focaltech,display-coords = <0 0 1080 1920>;
		focaltech,panel-coords = <0 0 1080 1920>;
		focaltech,button-map= <139 102 158>;
		focaltech,no-force-update;
		focaltech,i2c-pull-up;
		focaltech,group-id = <1>;
		focaltech,hard-reset-delay-ms = <20>;
		focaltech,soft-reset-delay-ms = <200>;
		focaltech,num-max-touches = <5>;
		focaltech,fw-delay-aa-ms = <30>;
		focaltech,fw-delay-55-ms = <30>;
		focaltech,fw-upgrade-id1 = <0x79>;
		focaltech,fw-upgrade-id2 = <0x18>;
		focaltech,fw-delay-readid-ms = <10>;
		focaltech,fw-delay-era-flsh-ms = <2000>;
		focaltech,fw-auto-cal;
		focaltech,ignore-id-check;
	};*/
goodix_ts@5d {
			compatible = "goodix,gt9xx";
			reg = <0x5d>;
			interrupt-parent = <&tlmm>;
			interrupts = <65 0x2008>;
			vdd_ana-supply = <&pm8917_l10>;
			vcc_i2c-supply = <&pm8917_l5>;
			/* pins used by touchscreen */
			/*
			pinctrl-names = "pmx_ts_active","pmx_ts_suspend","pmx_ts_release";
			pinctrl-0 = <&ts_int_active &ts_reset_active>;
			pinctrl-1 = <&ts_int_suspend &ts_reset_suspend>;
			pinctrl-2 = <&ts_release>;
		        */ 				
			goodix,rst-gpio = <&tlmm 64 0x00>;
			goodix,irq-gpio = <&tlmm 65 0x2008>;
			goodix,cfg-group0 = [
				53 38 04 80 07 0A 35 01 02 18 37 05 50 32 0A 01 00 00 00 13 33 22 00 16 18 1A 14 8C 2E 0E 2B 2D 42 19 00 00 00 03 22 2D 00 00 00 00 00 00 00 00 00 00 03 23 3C 4F A5 52 08 00 00 04 9C 24 00 90 29 1E 87 2D 00 80 33 00 6E 38 11 6B 20 30 50 00 F7 50 40 9F AF 27 00 00 00 00 00 00 00 00 53 64 00 00 00 00 00 00 00 00 00 05 50 00 00 00 00 28 1C 1A 18 16 14 12 10 0E 0C 0A 08 06 04 02 00 00 0A 40 28 02 03 33 01 05 32 01 28 00 00 00 00 02 04 06 08 0A 0C 0F 10 12 13 14 16 2A 29 28 26 24 22 21 20 1F 1E 1D 1C 18 00 00 00 00 00 00 00 00 00 00 00 00 00 00 00 00 67 01];
                       goodix,cfg-group1 = [
				53 38 04 80 07 0A 35 01 02 18 3C 05 41 2D 0A 01 00 00 00 13 33 22 00 16 18 1A 14 8C 2E 0E 2D 2F 3F 17 00 00 00 03 22 2D 00 00 00 00 00 00 00 00 00 00 03 23 3C 4F 95 02 08 00 00 04 9C 24 00 90 29 1E 87 2D 00 80 33 00 6E 38 11 6B 08 60 70 00 F7 50 40 9F 9F 27 00 00 00 00 00 00 00 00 53 64 00 00 00 00 00 00 00 00 00 05 50 00 00 00 00 28 02 04 06 08 1A 1C 0A 18 16 14 12 0E 0C 10 00 00 0A 40 28 02 03 33 01 0A 32 01 28 00 00 00 29 28 26 21 1F 1D 2A 24 22 20 1E 1C 16 18 00 02 04 06 0A 0C 0F 10 08 12 13 14 00 00 00 00 00 00 00 00 00 00 00 00 00 00 00 00 AA 01];
			goodix,cfg-group2 = [
                                46 38 04 80 07 0A 05 01 01 08 3C 05 55 2D 0A 02 00 00 00 00 33 22 00 16 1A 1D 14 8C 2E 0E 35 37 A6 0F 00 00 00 9A 03 11 00 00 00 00 00 00 00 00 00 00 00 34 4D 4F C5 02 00 00 00 04 7E 36 00 79 3A 00 74 3F 00 6E 44 00 69 4A 00 6B 08 60 70 00 00 50 40 89 A9 27 00 00 00 00 00 00 00 00 00 00 00 00 00 00 00 03 00 00 00 00 00 00 00 00 00 00 02 04 06 08 1A 1C 0A 18 16 14 12 0E 0C 10 00 00 00 00 00 00 00 00 00 00 00 00 00 00 00 00 29 28 26 21 1F 1D 2A 24 22 20 1E 1C 16 18 00 02 04 06 0A 0C 0F 10 08 12 13 14 00 00 00 00 00 00 00 00 00 00 00 00 00 00 00 00 59 01];
                       goodix,cfg-group3 = [];
                       goodix,cfg-group4 = [
				53 38 04 80 07 0A 35 01 02 18 37 05 5A 4B 0A 01 00 00 00 13 33 22 00 16 18 1A 14 8C 2E 0E 32 34 39 13 33 0F 00 24 34 1D 02 02 02 02 28 00 00 00 00 00 04 22 4B 4F 95 02 08 00 00 04 9C 24 00 90 2B 1E 87 32 00 80 3B 00 6E 45 11 69 20 30 50 00 F7 50 40 CF AF 27 00 00 00 02 2D 82 00 00 53 64 00 00 00 00 00 00 00 00 00 05 50 82 87 00 00 28 1C 1A 18 16 14 12 10 0E 0C 0A 08 06 04 02 00 00 0A 40 28 02 03 33 01 05 32 01 28 00 00 00 00 02 04 06 08 0A 0C 0F 10 12 13 14 16 2A 29 28 26 24 22 21 20 1F 1E 1D 1C 18 00 00 00 00 00 00 00 00 00 00 00 00 00 00 00 00 FD 01];
                       goodix,cfg-group5 = [
				53 38 04 80 07 0A 35 01 02 18 3C 05 5A 4B 0A 01 00 00 00 13 33 22 00 16 18 1A 14 8C 2E 0E 32 34 39 13 33 0F 00 2C 34 1D 00 02 02 02 28 00 00 00 00 00 03 22 4B 4A 95 02 08 00 00 04 9C 24 00 90 2B 1E 87 32 00 80 3B 00 6E 45 11 69 08 60 70 00 FA 50 40 CF BF 27 00 00 00 02 64 87 00 00 53 64 00 00 00 00 00 00 00 00 00 05 46 7D 82 00 00 28 02 04 06 08 1A 1C 0A 18 16 14 12 0E 0C 10 00 00 0A 00 00 00 00 00 01 05 32 01 28 00 00 00 29 28 26 21 1F 1D 2A 24 22 20 1E 1C 16 18 00 02 04 06 0A 0C 0F 10 08 12 13 14 00 00 00 00 00 00 00 00 00 00 00 00 00 00 00 00 25 01];
                       goodix,cfg-group6 = [];
                       goodix,cfg-group7 = [];
                       goodix,cfg-group8 = [48 D0 02 00 05 0A 05 01 01 08 30 05 52 2D 0A 04 00 00 00 00 33 22 00 16 1A 1D 14 8C 2E 0E 35 37 A6 0F 00 00 00 9A 23 11 00 00 00 00 00 00 00 00 00 00 03 34 4D 4F 85 02 00 00 00 04 7E 36 00 79 3A 1E 74 3F 00 6E 44 00 69 4A 11 6B 08 60 70 00 00 50 40 FF FF 27 00 00 00 00 00 00 00 00 FF FF 00 00 00 00 00 00 00 00 00 05 50 00 00 00 00 28 02 04 06 08 1A 1C 0A 18 16 14 12 0E 0C 10 00 00 00 08 32 05 02 00 01 00 32 03 28 00 00 00 29 28 26 21 1F 1D 2A 24 22 20 1E 1C 16 18 00 02 04 06 0A 0C 0F 10 08 12 13 14 00 00 00 00 00 00 00 00 00 00 00 00 00 00 00 00 5B 01];
                       goodix,cfg-group9 = [
				49 D0 02 00 05 0A 05 01 01 08 30 05 52 2D 0A 04 00 00 00 00 33 22 00 16 1A 1D 14 8C 2E 0E 35 37 A6 0F 00 00 00 9A 23 11 00 00 00 00 00 00 00 00 00 00 03 34 4D 4F 85 02 00 00 00 04 7E 36 00 79 3A 1E 74 3F 00 6E 44 00 69 4A 11 6B 70 18 08 00 00 50 40 FF FF 27 00 00 00 00 00 00 00 00 FF FF 00 00 00 00 00 00 00 00 00 05 50 00 00 00 00 28 10 0C 0E 12 14 16 18 0A 1C 1A 08 06 04 02 00 00 00 08 32 05 02 00 01 00 32 03 28 00 00 00 29 28 26 21 1F 1D 2A 24 22 20 1E 1C 16 18 00 02 04 06 0A 0C 0F 10 08 12 13 14 00 00 00 00 00 00 00 00 00 00 00 00 00 00 00 00 A2 01];
                       goodix,cfg-group10 = [];
                       goodix,cfg-group11 = [];
                       goodix,cfg-group12 = [];
                       goodix,cfg-group13 = [
				49 D0 02 00 05 0A 05 01 01 08 30 05 52 2D 0A 04 00 00 00 00 33 22 00 16 1A 1D 14 8C 2E 0E 35 37 A6 0F 00 00 00 9C 23 11 0A 01 04 02 3C 00 00 00 00 00 03 34 4D 4F 85 02 00 00 00 04 7E 36 00 79 3A 1E 74 3F 00 6E 44 00 69 4A 11 6B 70 18 08 00 00 50 40 FF FF 27 00 00 00 01 6E 7D 1E 6E FF FF 00 00 00 00 00 00 00 00 00 05 50 6E 7D 1E 6E 28 10 0C 0E 12 14 16 18 0A 1C 1A 08 06 04 02 00 00 00 08 32 05 02 00 01 00 32 03 28 00 00 00 29 28 26 21 1F 1D 2A 24 22 20 1E 1C 16 18 00 02 04 06 0A 0C 0F 10 08 12 13 14 00 00 00 00 00 00 00 00 00 00 00 00 00 00 00 00 64 01];
		};
};
