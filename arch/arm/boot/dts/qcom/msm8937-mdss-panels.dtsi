/* Copyright (c) 2015-2016, The Linux Foundation. All rights reserved.
 *
 * This program is free software; you can redistribute it and/or modify
 * it under the terms of the GNU General Public License version 2 and
 * only version 2 as published by the Free Software Foundation.
 *
 * This program is distributed in the hope that it will be useful,
 * but WITHOUT ANY WARRANTY; without even the implied warranty of
 * MERCHANTABILITY or FITNESS FOR A PARTICULAR PURPOSE.  See the
 * GNU General Public License for more details.
 */

#include "dsi-panel-sim-video.dtsi"
#include "dsi-panel-sim-cmd.dtsi"
#include "dsi-panel-truly-1080p-video.dtsi"
#include "dsi-panel-truly-1080p-cmd.dtsi"
#include "dsi-panel-r69006-1080p-cmd.dtsi"
#include "dsi-panel-r69006-1080p-video.dtsi"
#include "dsi-panel-hx8394f-720p-video.dtsi"
#include "dsi-adv7533-1080p.dtsi"
#include "dsi-adv7533-720p.dtsi"
#include "dsi-panel-truly-720p-video.dtsi"
#include "dsi-panel-otm1284a-720p-video.dtsi"
#include "dsi-panel-truly-wuxga-video.dtsi"
#include "dsi-panel-truly-720p-cmd.dtsi"
#include "dsi-panel-tm5p5-nt35596-1080p-video.dtsi"
#include "dsi-panel-auo-nt35596-1080p-video.dtsi"
#include "dsi-panel-auo5p5-nt35596-1080p-video.dtsi"
//ASUS_BSP Show_Wang +++ [Scorpio][Display][NA][Spec]Bring up CTC & TM panel for Scorpio SR
#include "dsi-panel-PJ055IC-1080p-video.dtsi"
#include "dsi-panel-TM-TL055VDXP55-1080p-video.dtsi"
//ASUS_BSP Show_Wang --- [Scorpio][Display][NA][Spec]Bring up CTC & TM panel for Scorpio SR
#include "dsi-panel-cpt5p5-otm1284a-720p-video.dtsi"
#include "dsi-panel-ctc-jd9365-720p-video.dtsi"
#include "dsi-panel-tm-ili9881-720p-video.dtsi"
//ASUS_BSP Show_Wang +++ [Scorpio][Display][NA][Spec]Bring up BOE panel for Scorpio
#include "dsi-panel-boe-ili9881-720p-video.dtsi"
//ASUS_BSP Show_Wang --- [Scorpio][Display][NA][Spec]Bring up BOE panel for Scorpio
#include "dsi-panel-lead-fl10802-fwvga-video.dtsi"

&soc {
	dsi_panel_pwr_supply: dsi_panel_pwr_supply {
		#address-cells = <1>;
		#size-cells = <0>;

		qcom,panel-supply-entry@0 {
			reg = <0>;
			qcom,supply-name = "vdd";
			qcom,supply-min-voltage = <2850000>;
			qcom,supply-max-voltage = <2900000>;
			qcom,supply-enable-load = <100000>;
			qcom,supply-disable-load = <100>;
		};

		qcom,panel-supply-entry@1 {
			reg = <1>;
			qcom,supply-name = "vddio";
			qcom,supply-min-voltage = <1800000>;
			qcom,supply-max-voltage = <1800000>;
			qcom,supply-enable-load = <100000>;
			qcom,supply-disable-load = <100>;
		};

	};
};
