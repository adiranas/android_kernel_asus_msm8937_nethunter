/* Copyright (c) 2013, The Linux Foundation. All rights reserved.
 *
 * This program is free software; you can redistribute it and/or modify
 * it under the terms of the GNU General Public License version 2 and
 * only version 2 as published by the Free Software Foundation.
 *
 * This program is distributed in the hope that it will be useful,
 * but WITHOUT ANY WARRANTY; without even the implied warranty of
 * MERCHANTABILITY or FITNESS FOR A PARTICULAR PURPOSE.  See the
 * GNU General Public License for more details.
 */

/*---------------------------------------------------------------------------
 * This file is autogenerated file using gcdb parser. Please do not edit it.
 * Update input XML file to add a new entry or update variable in this file
 * VERSION = "1.0"
 *---------------------------------------------------------------------------*/
&mdss_mdp {
	dsi_ctc_jd9365_720p_video: qcom,mdss_dsi_ctc_jd9365_720p_video {
		qcom,mdss-dsi-panel-name = "ctc jd9365 720p video mode dsi panel";
		qcom,mdss-dsi-panel-controller = <&mdss_dsi0>;
		qcom,mdss-dsi-panel-type = "dsi_video_mode";
		qcom,mdss-dsi-panel-destination = "display_1";
		qcom,mdss-dsi-panel-framerate = <60>;
		qcom,mdss-dsi-virtual-channel-id = <0>;
		qcom,mdss-dsi-stream = <0>;
		qcom,mdss-dsi-panel-width = <720>;
		qcom,mdss-dsi-panel-height = <1280>;
		qcom,mdss-dsi-h-front-porch = <56>;
		qcom,mdss-dsi-h-back-porch = <64>;
		qcom,mdss-dsi-h-pulse-width = <4>;
		qcom,mdss-dsi-h-sync-skew = <0>;
		qcom,mdss-dsi-v-back-porch = <16>;
		qcom,mdss-dsi-v-front-porch = <16>;
		qcom,mdss-dsi-v-pulse-width = <4>;
		qcom,mdss-dsi-h-left-border = <0>;
		qcom,mdss-dsi-h-right-border = <0>;
		qcom,mdss-dsi-v-top-border = <0>;
		qcom,mdss-dsi-v-bottom-border = <0>;
		qcom,mdss-dsi-bpp = <24>;
		qcom,mdss-dsi-color-order = "rgb_swap_rgb";
		qcom,mdss-dsi-underflow-color = <0xff>;
		qcom,mdss-dsi-border-color = <0>;
		qcom,mdss-dsi-on-command = [39 01 00 00 00 00 02 E0 00
			39 01 00 00 00 00 02 E1 93
			39 01 00 00 00 00 02 E2 65
			39 01 00 00 00 00 02 E3 F8
			39 01 00 00 00 00 02 80 03
			39 01 00 00 00 00 02 E0 04
			39 01 00 00 00 00 02 2D 03
			39 01 00 00 00 00 02 E0 01
			39 01 00 00 00 00 02 17 00
			39 01 00 00 00 00 02 18 E7
			39 01 00 00 00 00 02 19 00
			39 01 00 00 00 00 02 1A 00
			39 01 00 00 00 00 02 1B E7
			39 01 00 00 00 00 02 1C 00
			39 01 00 00 00 00 02 1F 77
			39 01 00 00 00 00 02 20 26
			39 01 00 00 00 00 02 21 26
			39 01 00 00 00 00 02 22 7E
			39 01 00 00 00 00 02 35 76
			39 01 00 00 00 00 02 37 09
			39 01 00 00 00 00 02 38 04
			39 01 00 00 00 00 02 39 08
			39 01 00 00 00 00 02 3A 12
			39 01 00 00 00 00 02 3C 7C
			39 01 00 00 00 00 02 3D FF
			39 01 00 00 00 00 02 3E FF
			39 01 00 00 00 00 02 3F 7F
			39 01 00 00 00 00 02 40 04
			39 01 00 00 00 00 02 41 A0
			39 01 00 00 00 00 02 43 10
			39 01 00 00 00 00 02 44 13
			39 01 00 00 00 00 02 45 44
			39 01 00 00 00 00 02 55 0F
			39 01 00 00 00 00 02 56 01
			39 01 00 00 00 00 02 57 A5
			39 01 00 00 00 00 02 58 0A
			39 01 00 00 00 00 02 59 0A
			39 01 00 00 00 00 02 5A 35
			39 01 00 00 00 00 02 5B 12
			39 01 00 00 00 00 02 5C 16
			39 01 00 00 00 00 02 E0 02
			39 01 00 00 00 00 02 00 4A
			39 01 00 00 00 00 02 01 48
			39 01 00 00 00 00 02 02 46
			39 01 00 00 00 00 02 03 44
			39 01 00 00 00 00 02 04 40
			39 01 00 00 00 00 02 05 55
			39 01 00 00 00 00 02 06 55
			39 01 00 00 00 00 02 07 55
			39 01 00 00 00 00 02 08 55
			39 01 00 00 00 00 02 09 55
			39 01 00 00 00 00 02 0A 55
			39 01 00 00 00 00 02 0B 55
			39 01 00 00 00 00 02 0C 55
			39 01 00 00 00 00 02 0D 55
			39 01 00 00 00 00 02 0E 55
			39 01 00 00 00 00 02 0F 55
			39 01 00 00 00 00 02 10 55
			39 01 00 00 00 00 02 11 55
			39 01 00 00 00 00 02 12 57
			39 01 00 00 00 00 02 13 58
			39 01 00 00 00 00 02 14 55
			39 01 00 00 00 00 02 15 55
			39 01 00 00 00 00 02 16 4B
			39 01 00 00 00 00 02 17 49
			39 01 00 00 00 00 02 18 47
			39 01 00 00 00 00 02 19 45
			39 01 00 00 00 00 02 1A 41
			39 01 00 00 00 00 02 1B 55
			39 01 00 00 00 00 02 1C 55
			39 01 00 00 00 00 02 1D 55
			39 01 00 00 00 00 02 1E 55
			39 01 00 00 00 00 02 1F 55
			39 01 00 00 00 00 02 20 55
			39 01 00 00 00 00 02 21 55
			39 01 00 00 00 00 02 22 55
			39 01 00 00 00 00 02 23 55
			39 01 00 00 00 00 02 24 55
			39 01 00 00 00 00 02 25 55
			39 01 00 00 00 00 02 26 55
			39 01 00 00 00 00 02 27 55
			39 01 00 00 00 00 02 28 57
			39 01 00 00 00 00 02 29 58
			39 01 00 00 00 00 02 2A 55
			39 01 00 00 00 00 02 2B 55
			39 01 00 00 00 00 02 2C 09
			39 01 00 00 00 00 02 2D 0B
			39 01 00 00 00 00 02 2E 05
			39 01 00 00 00 00 02 2F 07
			39 01 00 00 00 00 02 30 1F
			39 01 00 00 00 00 02 31 01
			39 01 00 00 00 00 02 32 1F
			39 01 00 00 00 00 02 33 1F
			39 01 00 00 00 00 02 34 1F
			39 01 00 00 00 00 02 35 1F
			39 01 00 00 00 00 02 36 1F
			39 01 00 00 00 00 02 37 1F
			39 01 00 00 00 00 02 38 1F
			39 01 00 00 00 00 02 39 1F
			39 01 00 00 00 00 02 3A 1F
			39 01 00 00 00 00 02 3B 1F
			39 01 00 00 00 00 02 3C 1F
			39 01 00 00 00 00 02 3D 1F
			39 01 00 00 00 00 02 3E 17
			39 01 00 00 00 00 02 3F 18
			39 01 00 00 00 00 02 40 1F
			39 01 00 00 00 00 02 41 1F
			39 01 00 00 00 00 02 42 08
			39 01 00 00 00 00 02 43 0A
			39 01 00 00 00 00 02 44 04
			39 01 00 00 00 00 02 45 06
			39 01 00 00 00 00 02 46 1F
			39 01 00 00 00 00 02 47 00
			39 01 00 00 00 00 02 48 1F
			39 01 00 00 00 00 02 49 1F
			39 01 00 00 00 00 02 4A 1F
			39 01 00 00 00 00 02 4B 1F
			39 01 00 00 00 00 02 4C 1F
			39 01 00 00 00 00 02 4D 1F
			39 01 00 00 00 00 02 4E 1F
			39 01 00 00 00 00 02 4F 1F
			39 01 00 00 00 00 02 50 1F
			39 01 00 00 00 00 02 51 1F
			39 01 00 00 00 00 02 52 1F
			39 01 00 00 00 00 02 53 1F
			39 01 00 00 00 00 02 54 17
			39 01 00 00 00 00 02 55 18
			39 01 00 00 00 00 02 56 1F
			39 01 00 00 00 00 02 57 1F
			39 01 00 00 00 00 02 58 40
			39 01 00 00 00 00 02 5C 0A
			39 01 00 00 00 00 02 5D 20
			39 01 00 00 00 00 02 63 6C
			39 01 00 00 00 00 02 64 6C
			39 01 00 00 00 00 02 67 72
			39 01 00 00 00 00 02 68 0C
			39 01 00 00 00 00 02 69 6C
			39 01 00 00 00 00 02 6A 64
			39 01 00 00 00 00 02 6D 04
			39 01 00 00 00 00 02 78 23
			39 01 00 00 00 00 02 7F 40
			39 01 00 00 00 00 02 E0 04
			39 01 00 00 00 00 02 09 14
			39 01 00 00 00 00 02 0E 38
			39 01 00 00 00 00 02 2B 2B
			39 01 00 00 00 00 02 2E 44
			39 01 00 00 00 00 02 E0 00
			39 01 00 00 00 00 02 E6 02
			39 01 00 00 0A 00 02 E7 06
			05 01 00 00 78 00 02 11 00
			05 01 00 00 78 00 02 29 00];
		qcom,mdss-dsi-off-command = [05 01 00 00 14 00 02 28 00
					05 01 00 00 78 00 02 10 00];
		qcom,mdss-dsi-on-command-state = "dsi_lp_mode";
		qcom,mdss-dsi-off-command-state = "dsi_lp_mode";
		qcom,mdss-dsi-h-sync-pulse = <1>;
		qcom,mdss-dsi-traffic-mode = "burst_mode";
		qcom,mdss-dsi-lane-map = "lane_map_0123";
		qcom,mdss-dsi-bllp-eof-power-mode;
		qcom,mdss-dsi-bllp-power-mode;
		qcom,mdss-dsi-lane-0-state;
		qcom,mdss-dsi-lane-1-state;
		qcom,mdss-dsi-lane-2-state;
		qcom,mdss-dsi-lane-3-state;
		qcom,mdss-dsi-panel-timings = [76 1A 10 00 3C 40 14 1C 12 03 04 00];
		qcom,mdss-dsi-t-clk-post = <0x04>;
		qcom,mdss-dsi-t-clk-pre = <0x19>;
		qcom,mdss-dsi-bl-min-level = <12>;
		qcom,mdss-dsi-bl-max-level = <4095>;
		qcom,mdss-dsi-dma-trigger = "trigger_sw";
		qcom,mdss-dsi-mdp-trigger = "none";
		qcom,mdss-dsi-bl-pmic-control-type = "bl_ctrl_wled";
		qcom,mdss-dsi-reset-sequence = <1 10>, <0 30>, <1 10>;
                qcom,mdss-pan-physical-width-dimension = <68>; //width of picture in mm (for xdpi)
		qcom,mdss-pan-physical-height-dimension = <121>; //height of picture in mm (for ydpi)
		qcom,mdss-dsi-lp11-init;
	};
};
